## Kconfig
```kconfig
menu "EPOS CAN Configuration"

    menu "EPOS Console UART configuration"
    config EPOS_CONSOLE_PROMPT
        string "Prompt used in interactive console"
        default "> "
        help
            Prompt used in interactive console to show willingness to receive commands.

    config EPOS_CONSOLE_UART_NUM
        int "UART port used by the interactive console"
        default 0
        range 0 2
        help
            UART peripheral used when canopen_console_cfg_t.enable_uart_console is true.

    config EPOS_CONSOLE_UART_TX_PIN
        int "UART console TX GPIO"
        default 43
        help
            GPIO used as TX for the UART console by default.

    config EPOS_CONSOLE_UART_RX_PIN
        int "UART console RX GPIO"
        default 44
        help
            GPIO used as RX for the UART console by default.

    config EPOS_CONSOLE_UART_BAUD_RATE
        int "UART console baud rate"
        default 115200
        help
            Baud rate used by the UART console by default.
    endmenu

endmenu
```

## examples/idf/main/Kconfig.projbuild
```kconfig
menu "EPOS example configuration"

    choice EPOS_EXAMPLE_CONSOLE_TRANSPORT
        prompt "Interactive console transport"
        default EPOS_EXAMPLE_CONSOLE_UART
        help
            Selects the transport used by the interactive EPOS console in this
            example. UART0 is the default so the firmware does not depend on a
            connected USB Serial/JTAG host during boot.

        config EPOS_EXAMPLE_CONSOLE_UART
            bool "UART0"

        config EPOS_EXAMPLE_CONSOLE_USB_SERIAL_JTAG
            bool "USB Serial/JTAG"
            depends on SOC_USB_SERIAL_JTAG_SUPPORTED
            select ESP_CONSOLE_USB_SERIAL_JTAG

    endchoice

endmenu
```
